## build/conf/bblayers.conf
```bitbake
# POKY_BBLAYERS_CONF_VERSION is increased each time build/conf/bblayers.conf
# changes incompatibly
POKY_BBLAYERS_CONF_VERSION = "2"

BBPATH = "${TOPDIR}"
BBFILES ?= ""

BBLAYERS ?= " \
  /home/xpahos/yocto/morty/poky/meta \
  /home/xpahos/yocto/morty/poky/meta-poky \
  /home/xpahos/yocto/morty/poky/meta-yocto-bsp \
  /home/xpahos/yocto/morty/poky/meta-altera \
  /home/xpahos/yocto/morty/poky/meta-linaro/meta-linaro-toolchain \
  "
```
